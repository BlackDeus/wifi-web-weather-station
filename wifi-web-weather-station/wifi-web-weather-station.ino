// Sensor wird definiert
#define DHT_TYPE DHT11
#define DHT_PIN D5
#define DHT_POWER D0
DHT dht (DHT_PIN, DHT_TYPE);

// OLED Pins
#define OLED_SCL GPIO5 
#define OLED_SDA GPIO4
#define OLED_RESET -1

// Display Objekt
Adafruit_SSD1306 display(128 ,64 , &Wire , OLED_RESET);

// Webserver auf Port 80
ESP8266WebServer server(80);

// -----------------------WICHTIG-----------------------
bool useAP = true;  // true = hotspot, false = WLAN

// Wenn Sie mit WLAN verbinden wollen:
// Setzen Sie useAP auf FALSE und aendern Sie ssid and Wifi
const char* ssid = "ESP8266_Dima";
const char* password = "12345678";
// -----------------------WICHTIG-----------------------

// LED Pins
const int LED_ROT = D8;
const int LED_GELB =D7;
const int LED_GRUN = D6;

// Struktur für LEDs
struct LED_Config {
  const char* name;
  int pin;
};

// LED Liste
LED_Config leds[] = {
  {"ROT", LED_ROT},
  {"GELB", LED_GELB},
  {"GRUN", LED_GRUN}
};

// globale Variablen für Sensorwerte
float temperature = 0;
float humidity = 0;
int brightness = 0;

// Zeitsteuerung für Display
unsigned long lastSwitch = 0;
bool showBitmap = true;

const unsigned char myBitmap [] PROGMEM = { // Hier soll mein Gesicht sein, aber...
0x0f, 0xff, 0xff, 0xf8, 0x00, 0x00, 0x00, 0x00, 0x00, 0x00, 0x00, 0x03, 0xff, 0x00, 0x00, 0x00, 
0x0f, 0xff, 0xff, 0xfc, 0x00, 0x00, 0x00, 0x00, 0x00, 0x00, 0x00, 0x0f, 0xff, 0x80, 0x00, 0x00, 
0x1f, 0xff, 0xff, 0xfe, 0x00, 0x00, 0x00, 0x00, 0x00, 0x00, 0x00, 0x3f, 0xe7, 0xc0, 0x00, 0x00, 
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0x1f, 0xf8, 0x3f, 0xff, 0xff, 0xff, 0xff, 0xff, 0x00, 0x00, 0x0f, 0xff, 0xff, 0xff, 0xff, 0xe1
};



const char HTML_HUB[] PROGMEM = R"=====(
  <!DOCTYPE html>
<html lang="de">
<head>
  <meta charset="UTF-8">
  <title>Mini Wetterstation</title>
  <style>
    body { font-family: Arial; text-align: center; margin-top: 50px; }
    button { font-size: 18px; padding: 10px 20px; margin: 10px; cursor: pointer; }
  </style>
</head>
<body>
  <h1>Projekt-HUB</h1>

  <!-- Кнопки-переключатели -->
  <button onclick="location.href='/page1'">Wetterstation</button>
  <button onclick="location.href='/page2'">LED Kontrolle</button>

  <div id="content">
    <p>Willkommen auf der Projektshub!</p>
  </div>
</body>
</html> )=====";

const char HTML_LED[] PROGMEM = R"=====(
  <!DOCTYPE html>
<html lang="de">
<head>
  <meta charset="UTF-8">
  <title>Lichtschalter</title>
  <style>
    body { font-family: Arial, sans-serif; text-align: center; margin-top: 30px; }
    table { margin: 0 auto; border-collapse: collapse; }
    th, td { padding: 10px 20px; }
    button { font-size: 16px; padding: 8px 16px; margin: 5px; cursor: pointer; }
    th { background-color: #f2f2f2; }
  </style>
</head>
<body>
  <h1>Lichtschalter</h1>

  <table border="1">
    <tr>
      <th>Farbe</th>
      <th>AN</th>
      <th>AUS</th>
    </tr>
    <tr>
      <td>ROT</td>
      <td><a href="/LED_ROT=ON"><button>AN</button></a></td>
      <td><a href="/LED_ROT=OFF"><button>AUS</button></a></td>
    </tr>
    <tr>
      <td>GELB</td>
      <td><a href="/LED_GELB=ON"><button>AN</button></a></td>
      <td><a href="/LED_GELB=OFF"><button>AUS</button></a></td>
    </tr>
    <tr>
      <td>GRÜN</td>
      <td><a href="/LED_GRUN=ON"><button>AN</button></a></td>
      <td><a href="/LED_GRUN=OFF"><button>AUS</button></a></td>
    </tr>
  </table>
</body>
</html> )=====";

const char HTML_WETTER[] = R"=====(
  <!DOCTYPE html>
  <html lang="de">
  <head>
  <meta charset="UTF-8">
  <title>Mini Wetterstation</title>
  <style>
    body { font-family: Arial, sans-serif; text-align: center; margin-top: 30px; background: #e0f7fa; }
    h1 { color: #00796b; }
    .card { display: inline-block; padding: 20px; margin: 15px; border-radius: 15px; background: #ffffff;
            box-shadow: 0 4px 8px rgba(0,0,0,0.2); width: 200px; }
    .value { font-size: 2em; font-weight: bold; margin-top: 10px; }
  </style>
  </head>
  <body>

  <h1>🌤 Mini Wetterstation</h1>

  <div class="card">
    <div>Temperatur</div>
    <div class="value">%TEMP% °C</div>
  </div>

  <div class="card">
    <div>Luftfeuchtigkeit</div>
    <div class="value">%HUM% %</div>
  </div>

  <div class="card">
    <div>Helligkeit</div>
    <div class="value">%BRT% %</div>
  </div>

  <p>Seite wird alle 5 Sekunden aktualisiert.</p>
  <meta http-equiv="refresh" content="5">

  </body>
  </html>)=====";

// Ausgabe auf dem Display
void displayOutput(){
  display.clearDisplay();
  
  if (showBitmap){
    // Bild anzeigen
    display.drawBitmap(0, 0, myBitmap, 128, 64, WHITE);
    display.display();
  } 
  else {
    // Text anzeigen
    display.setCursor(0,0);
    display.clearDisplay();
    display.setTextSize(1.5);
    display.setTextColor(WHITE);
    
    display.print("SSID: ");
    display.print(ssid);
    display.println();
    
    display.print("Passwort: ");
    display.print(password);
    display.println();

    // IP je nach Modus anzeigen
    if (useAP) {
      display.print("IP: ");
      display.print(WiFi.softAPIP());
    }
    else 
    {
      display.print(WiFi.localIP());
    }
    
    display.display();
  }
}

// LED Steuerung
void handle_LED() {
  String path = server.uri(); 

  for (int i = 0; i < 3; i++) {
    String ledOn  = "/LED_" + String(leds[i].name) + "=ON";
    String ledOff = "/LED_" + String(leds[i].name) + "=OFF";

    if (path == ledOn) {
      digitalWrite(leds[i].pin, HIGH); // LED an
    } else if (path == ledOff) {
      digitalWrite(leds[i].pin, LOW); // LED aus
    }
  }
}

// Wetterseite erzeugen
void handleWetter() {
  String page = HTML_WETTER;

  // Platzhalter ersetzen
  page.replace("%TEMP%", String(temperature, 1));
  page.replace("%HUM%", String(humidity, 0));
  page.replace("%BRT%", String(brightness, 0));

  server.send(200, "text/html", page);
}

// LED Seite senden
void handleLED() {
  server.send(200, "text/html", HTML_LED);
}

void setup() {
  
  // DHT Sensor einschalten
  pinMode(DHT_POWER, OUTPUT);
  digitalWrite(DHT_POWER, HIGH);

  dht.begin();
  
  // LEDs vorbereiten
  for (int i = 0; i < 3; i++) {
    pinMode(leds[i].pin, OUTPUT);
    digitalWrite(leds[i].pin, LOW);
  }
  
  // Display starten
  display.begin(SSD1306_SWITCHCAPVCC, 0x3c);
  display.clearDisplay();

  displayOutput();
  
  // WLAN Modus wählen
  if (useAP) {
    WiFi.mode(WIFI_AP);
    WiFi.softAP(ssid, password);
  }
  else {
    WiFi.mode(WIFI_STA);
    WiFi.begin(ssid, password);
  }

  // Routen definieren
  server.on("/", []() {
    server.send_P(200, "text/html", HTML_HUB);
  });

  server.on("/page1", handleWetter);
  server.on("/page2", handleLED);
  
  // LED Links
  server.on("/LED_ROT=ON", handle_LED);
  server.on("/LED_ROT=OFF", handle_LED);
  server.on("/LED_GELB=ON", handle_LED);
  server.on("/LED_GELB=OFF", handle_LED);
  server.on("/LED_GRUN=ON", handle_LED);
  server.on("/LED_GRUN=OFF", handle_LED);

  // Server starten
  server.begin();
}

void loop() {
  // Webserver bedienen
  server.handleClient();
  
  // Sensorwerte lesen
  temperature = dht.readTemperature();
  humidity  = dht.readHumidity();

  // Display alle 20 Sekunden wechseln
  if (millis() - lastSwitch > 20000) {
    showBitmap = !showBitmap;
    lastSwitch = millis();

    displayOutput();
  }
}
